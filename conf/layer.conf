## conf/layer.conf
```bitbake
# We have a conf and classes directory, append to BBPATH
BBPATH .= ":${LAYERDIR}"

# We have a recipes directory containing .bb and .bbappend files, add to BBFILES
BBFILES += "${LAYERDIR}/recipes-*/*/*.bb \
            ${LAYERDIR}/recipes-*/*/*.bbappend"

BBFILE_COLLECTIONS += "compulab-bsp-imx8mn"
BBFILE_PATTERN_compulab-bsp-imx8mn := "^${LAYERDIR}/"
BBFILE_PRIORITY_compulab-bsp-imx8mn = "9"

BBMASK += "meta-compulab/recipes-xfce"
BBMASK += "meta-compulab/recipes-kernel"
BBMASK += "meta-compulab/recipes-graphics"

LAYERSERIES_COMPAT_compulab-bsp-imx8mn = "zeus"

HOSTTOOLS += " git-lfs "
HOSTTOOLS += " bison "

IMAGE_INSTALL_append += " kernel-devicetree "
```

## conf/machine/mcm-imx8m-nano.conf
```bitbake
#@TYPE: Machine
#@NAME: CompuLab i.MX8MN Evaluation Kit
#@SOC: i.MX8MN
#@DESCRIPTION: Machine configuration for CompuLab i.MX8MN EVK
#@MAINTAINER: CompuLab <compulab@compulab.com>

MACHINEOVERRIDES =. "mx8:mx8m:mx8mn:"

require conf/machine/include/imx-base.inc
require conf/machine/include/tune-cortexa53.inc

MACHINE_FEATURES += " wifi bluetooth "

KERNEL_DEVICETREE = "compulab/mcm-imx8m-nano.dtb \
                     compulab/sbc-mcm-imx8m-nano.dtb \
"

UBOOT_CONFIG ??= "sd"
UBOOT_CONFIG[sd] = "mcm-imx8m-nano_defconfig,sdcard"
SPL_BINARY = "spl/u-boot-spl.bin"

# Set DDR FIRMWARE
DDR_FIRMWARE_NAME = "lpddr4_pmu_train_1d_imem.bin lpddr4_pmu_train_1d_dmem.bin lpddr4_pmu_train_2d_imem.bin lpddr4_pmu_train_2d_dmem.bin"

# Set u-boot DTB
UBOOT_DTB_NAME = "mcm-imx8m-nano.dtb"

# Set imx-mkimage boot target
IMXBOOT_TARGETS = "flash_evk"

SERIAL_CONSOLES = "115200;ttymxc2"

IMAGE_BOOTLOADER = "imx-boot"

BOOT_SPACE = "65536"

LOADADDR = ""
UBOOT_SUFFIX = "bin"
UBOOT_MAKE_TARGET = ""
IMX_BOOT_SEEK = "32"

PREFERRED_PROVIDER_virtual/kernel_mcm-imx8m-nano = "linux-compulab"
PREFERRED_PROVIDER_virtual/bootloader_mcm-imx8m-nano = "u-boot-compulab"

MACHINE_FIRMWARE += "firmware-imx-brcm"
MACHINE_FIRMWARE_remove = "linux-firmware-ath10k"
```
